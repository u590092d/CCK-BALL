## config/west.yml
```yaml
manifest:
  remotes:
    - name: zmkfirmware
      url-base: https://github.com/zmkfirmware
    - name: DoctorWangWang
      url-base: https://github.com/DoctorWangWang
  projects:
    - name: zmk
      remote: zmkfirmware
      revision: v0.3
      import: app/west.yml
    - name: zmk-pmw3610-driver
      url: https://github.com/badjeff/zmk-pmw3610-driver
      revision: main
      path: modules/drivers/zmk-pmw3610-driver

      
  self:
    path: config
```
